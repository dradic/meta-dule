## conf/bblayers.conf.sample
```bitbake
# POKY_BBLAYERS_CONF_VERSION is increased each time build/conf/bblayers.conf
# changes incompatibly
POKY_BBLAYERS_CONF_VERSION = "2"

BBPATH = "${TOPDIR}"
BBFILES ?= ""

BBLAYERS ?= " \
    ${HOME}/raspi/sources/poky/meta \
    ${HOME}/raspi/sources/poky/meta-poky \
    ${HOME}/raspi/sources/meta-openembedded/meta-oe \
    ${HOME}/raspi/sources/meta-openembedded/meta-multimedia \
    ${HOME}/raspi/sources/meta-openembedded/meta-networking \
    ${HOME}/raspi/sources/meta-openembedded/meta-perl \
    ${HOME}/raspi/sources/meta-openembedded/meta-python \
    ${HOME}/raspi/sources/meta-raspberrypi \
    ${HOME}/raspi/sources/meta-dule \
"
```

## conf/layer.conf
```bitbake
# We have a conf and classes directory, add to BBPATH
BBPATH .= ":${LAYERDIR}"

# We have recipes-* directories, add to BBFILES
BBFILES += "${LAYERDIR}/recipes-*/*/*.bb \
            ${LAYERDIR}/recipes-*/*/*.bbappend"

BBFILE_COLLECTIONS += "meta-dule"
BBFILE_PATTERN_meta-dule = "^${LAYERDIR}/"
BBFILE_PRIORITY_meta-dule = "7"

LAYERDEPENDS_meta-dule = "core"
LAYERSERIES_COMPAT_meta-dule = "hardknott"

MACHINE ?= "raspberrypi4"

ENABLE_UART = "1"

# Enable systemd
DISTRO_FEATURES_append = " systemd wayland weston pam"
DISTRO_FEATURES_BACKFILL_CONSIDERED = "sysvinit"
VIRTUAL-RUNTIME_init_manager = "systemd"
VIRTUAL-RUNTIME_initscripts = ""

IMAGE_INSTALL_append = " openssh \
                         htop \
                         tcpdump \
                         vlan \
			 dhcpcd \
                        "

CORE_IMAGE_EXTRA_INSTALL += "wayland weston"
```
